## Esp32/Components/led_strip/main/Kconfig.projbuild
```kconfig
menu "Example Configuration"
    config EXAMPLE_RMT_TX_GPIO_ONE
        int "RMT TX GPIO"
        default 17
        help
            Set the GPIO number used for transmitting the RMT signal.

    config EXAMPLE_RMT_TX_GPIO_TWO
        int "RMT TX GPIO"
        default 18
        help
            Set the GPIO number used for transmitting the RMT signal.

    config EXAMPLE_STRIP_LED_NUMBER
        int "Number of LEDS in a strip"
        default 11
        help
            A single RGB strip contains several LEDs.
endmenu
```
